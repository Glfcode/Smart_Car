/********************电赛阶段 ********************
 * 文件名  ：12864.c
 * 描述    ：定义的类型        
 * 作者    ：晓峰 
 * 硬件连接： -------------------------------
 *           |   |
 *           |   |
 *           |   |
 *           |   |
 *           |   |
 *            -------------------------------
 * 时间    ：2013年5月24 
***************************************************/
#include "config.h"

/*****************************************************************************
                    引脚定义  （板子不可变的）
/****************************************************************************/
#define		LCD12864_DB0_DB7		P0		    // 定义LCD1602的数据总线
sbit LCD12864_RS   = P2 ^ 3;			// 定义LCD1602的RS控制线
sbit LCD12864_RW   = P2 ^ 4;					// 定义LCD1602的RW控制线
sbit LCD12864_E    = P2 ^ 5;					// 定义LCD1602的E控制线
sbit PSB = P2^6;
/*****************************************************************************
定义LCD12864指令集 （详细请见查看12864指令集手册）
/****************************************************************************/
#define			CMD_clear		0x01             // 清除屏幕
#define			CMD_back		0x02             // DDRAM回零位
#define			CMD_base		0x30		      // 基础指令集
#define			CMD_expand		0x36		     // 扩展指令集
#define			CMD_display		0x0c             // 开显示_关光标_关光标闪烁
#define			CMD_set			0x38             // 8位总线_2行显示
#define			line_one		0x80             // 第一行写入地址
#define			line_two		0x90             // 第二行写入地址
#define			line_three		0x88             // 第三行写入地址
#define			line_four		0x98             // 第四行写入地址
/*****************************************************************************
函数名ELAY_MS ()
参数： unsigned int a
返回值：无
备注：毫秒级延迟函数
/****************************************************************************/

void DELAY_MS (unsigned int a)
{
	unsigned int i;
	while( a-- != 0)
	{
		for(i = 0; i < 600; i++);
	}
}
/*****************************************************************************
函数名：LCD12864_TestBusy（）
参数： 无
返回值：无
备注：LCD12864测忙，若LCD12864处于忙状态，本函数将等待至非忙状态
****************************************************************************/
void LCD12864_TestBusy(void)
{
	LCD12864_DB0_DB7=0xff;
	LCD12864_RS=0;
	LCD12864_RW=1;
	LCD12864_E=1;
   	while(LCD12864_DB0_DB7&0x80);
	LCD12864_E=0;
}

/*****************************************************************************
函数名：LCD12864_TestBusy（）
参数： unsigned char LCD12864_command
返回值：无
备注：写指令
****************************************************************************/

void LCD12864_WriteCMD(unsigned char LCD12864_command)
{
	LCD12864_TestBusy();
	LCD12864_RS=0;
	LCD12864_RW=0;
	LCD12864_E=1;
	LCD12864_DB0_DB7=LCD12864_command;
	LCD12864_E=0;
}	
			  
/*****************************************************************************
函数名CD12864_WriteData()
参数： unsigned char LCD12864_command
返回值：无
备注：  向LCD12864写数据

/****************************************************************************/
void LCD12864_WriteData(unsigned char LCD12864_data)
{
	LCD12864_TestBusy();
	LCD12864_RS=1;
	LCD12864_RW=0;
	LCD12864_E=1;
	LCD12864_DB0_DB7=LCD12864_data;
	LCD12864_E=0;
}

/*****************************************************************************
函数名print()
参数： unsigned char x,unsigned char y,unsigned char *str
返回值：无
备注：  打印字符串程序（本函数调用指针函数）向LCD发送一个字符串,长度64字符之内 
/****************************************************************************/
void print(unsigned char x,unsigned char y,unsigned char *str)
{
	LCD12864_WriteCMD(x+y);
	while(*str!='\0')
	{					
    	LCD12864_WriteData(*str++); 
	}
	*str=0;
}

/*****************************************************************************
函数名CD12864_Init()
参数： 无
返回值：无
备注：LCD12864初始化 
/****************************************************************************/
void LCD12864_Init(void)
{
	PSB = 1; // 选择并口模式
	LCD12864_WriteCMD(CMD_base);				//初始化下面指令均为基础指令
	LCD12864_WriteCMD(CMD_back);        //  DDRAM回零位,光标移到开头原点位置
	LCD12864_WriteCMD(CMD_display);			//	开显示_关光标_关光标闪烁
	LCD12864_WriteCMD(CMD_clear);				//  清屏
}
